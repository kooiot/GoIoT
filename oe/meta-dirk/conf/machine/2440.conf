## oe/meta-dirk/conf/machine/2440.conf
```bitbake
#@TYPE: Machine
#@NAME: tune-arm920t
#@DESCRIPTION: s3c2440 & atmel rm9200

require conf/machine/include/dirk.inc
require conf/machine/include/tune-arm920t.inc
#require conf/machine/include/tune-arm1136jf-s.inc

KERNEL_IMAGETYPE = "zImage"

SERIAL_CONSOLE = "115200 ttyAMA0"

TARGET_SYS_ARCH = "armv4t"
```

## oe/meta-dirk/conf/machine/include/dirk.inc
```bitbake
MACHINE_FEATURES = "usbgadget lua"

IMAGE_FSTYPES += "cramfs tar.bz2"

# Don't include kernels in standard images
RDEPENDS_kernel-base = ""

# Use a common kernel recipe for
PREFERRED_PROVIDER_virtual/kernel ?= "linux"
```
